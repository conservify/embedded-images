## configs/conservify-wifi-station_defconfig
```kconfig
BR2_arm=y
BR2_cortex_a53=y
BR2_ARM_FPU_NEON_VFPV4=y

BR2_TARGET_GENERIC_HOSTNAME="wifi-station"
BR2_TARGET_GENERIC_ISSUE="Welcome"

BR2_TOOLCHAIN_BUILDROOT_LOCALE=y
BR2_TOOLCHAIN_BUILDROOT_CXX=y

BR2_CCACHE=y
BR2_CCACHE_DIR="$(HOME)/.buildroot-ccache"

BR2_SYSTEM_DHCP="eth0"

# Linux headers same as kernel, a 4.14 series
BR2_PACKAGE_HOST_LINUX_HEADERS_CUSTOM_4_14=y

BR2_LINUX_KERNEL=y
BR2_LINUX_KERNEL_CUSTOM_TARBALL=y
BR2_LINUX_KERNEL_CUSTOM_TARBALL_LOCATION="$(call github,raspberrypi,linux,1f89ad77bf9b204c18fb6fdd167b4ee92d064f95)/linux-1f89ad77bf9b204c18fb6fdd167b4ee92d064f95.tar.gz"
# BR2_LINUX_KERNEL_DEFCONFIG="bcm2709"
BR2_LINUX_KERNEL_USE_CUSTOM_CONFIG=y
BR2_LINUX_KERNEL_CUSTOM_CONFIG_FILE="$(BR2_EXTERNAL_CONSERVIFY_PATH)/board/conservify/common/.config"

# Build the DTB from the kernel sources
BR2_LINUX_KERNEL_DTS_SUPPORT=y
BR2_LINUX_KERNEL_INTREE_DTS_NAME="bcm2710-rpi-3-b bcm2710-rpi-3-b-plus bcm2710-rpi-cm3"

BR2_PACKAGE_BUSYBOX_CONFIG="$(BR2_EXTERNAL_CONSERVIFY_PATH)/board/conservify/common/busybox.config"
BR2_PACKAGE_BUSYBOX_SHOW_OTHERS=y
BR2_PACKAGE_BZIP2=y
BR2_PACKAGE_XORG7=y
BR2_PACKAGE_XLIB_LIBXRENDER=y
BR2_PACKAGE_XLIB_LIBXT=y
BR2_PACKAGE_XLIB_LIBXTST=y
BR2_PACKAGE_LINUX_FIRMWARE=y
BR2_PACKAGE_RPI_FIRMWARE=y
BR2_PACKAGE_RPI_WIFI_FIRMWARE=y
BR2_PACKAGE_JAMVM=y
BR2_PACKAGE_ALSA_LIB=y
BR2_PACKAGE_FREETYPE=y
BR2_PACKAGE_LIBUSB=y
BR2_PACKAGE_WIRINGPI=y
BR2_PACKAGE_LIBFFI=y
BR2_PACKAGE_BRIDGE_UTILS=y
BR2_PACKAGE_CUPS=y
BR2_PACKAGE_DNSMASQ=y
# BR2_PACKAGE_DNSMASQ_TFTP is not set
BR2_PACKAGE_DROPBEAR=y
BR2_PACKAGE_HOSTAPD=y
BR2_PACKAGE_HOSTAPD_WPS=y
# BR2_PACKAGE_HOSTAPD_VLAN is not set
BR2_PACKAGE_IPTABLES=y
BR2_PACKAGE_IW=y
BR2_PACKAGE_MOSH=y
BR2_PACKAGE_NTP=y
BR2_PACKAGE_NTP_NTPDATE=y
BR2_PACKAGE_NTP_NTPTIME=y
BR2_PACKAGE_RSYNC=y
BR2_PACKAGE_WGET=y
BR2_PACKAGE_WIREGUARD=y
BR2_PACKAGE_WPA_SUPPLICANT=y
BR2_PACKAGE_WPA_SUPPLICANT_AP_SUPPORT=y
BR2_PACKAGE_WPA_SUPPLICANT_WPS=y
BR2_PACKAGE_WPA_SUPPLICANT_CLI=y
BR2_PACKAGE_WPA_SUPPLICANT_PASSPHRASE=y
BR2_PACKAGE_BASH=y
BR2_PACKAGE_LOGROTATE=y
BR2_PACKAGE_TMUX=y
BR2_PACKAGE_DCRON=y
BR2_PACKAGE_RSYSLOG=y
BR2_PACKAGE_UTIL_LINUX=y
BR2_PACKAGE_VIM=y

# Custom packages
# BR2_PACKAGE_BOW_TOOLS=y

# Required tools to create the SD image
BR2_PACKAGE_HOST_DOSFSTOOLS=y
BR2_PACKAGE_HOST_GENIMAGE=y
BR2_PACKAGE_HOST_MTOOLS=y

# Filesystem / image
BR2_ROOTFS_POST_SCRIPT_ARGS="--add-pi3-miniuart-bt-overlay"
BR2_TARGET_ROOTFS_CPIO=y
BR2_TARGET_ROOTFS_CPIO_GZIP=y
BR2_TARGET_ROOTFS_INITRAMFS=y
# BR2_TARGET_ROOTFS_TAR is not set

BR2_ROOTFS_OVERLAY="$(BR2_EXTERNAL_CONSERVIFY_PATH)/board/conservify/common/overlay $(BR2_EXTERNAL_CONSERVIFY_PATH)/board/conservify/wifi-station/overlay"
BR2_ROOTFS_POST_BUILD_SCRIPT="$(BR2_EXTERNAL_CONSERVIFY_PATH)/board/conservify/common/post_build.sh $(BR2_EXTERNAL_CONSERVIFY_PATH)/board/conservify/wifi-station/post_build.sh"
BR2_ROOTFS_POST_IMAGE_SCRIPT="$(BR2_EXTERNAL_CONSERVIFY_PATH)/board/conservify/common/post_image.sh $(BR2_EXTERNAL_CONSERVIFY_PATH)/board/conservify/wifi-station/post_image.sh"
```

## package/Config.in
```kconfig
menu "Conservify"
     source "$BR2_EXTERNAL_CONSERVIFY_PATH/package/bow-tools/Config.in"
     source "$BR2_EXTERNAL_CONSERVIFY_PATH/package/openjdk/Config.in"
     source "$BR2_EXTERNAL_CONSERVIFY_PATH/package/jenkins-agent/Config.in"
     source "$BR2_EXTERNAL_CONSERVIFY_PATH/package/wireguard-quick/Config.in"
     source "$BR2_EXTERNAL_CONSERVIFY_PATH/package/wifi-ap-helpers/Config.in"
     source "$BR2_EXTERNAL_CONSERVIFY_PATH/package/initramfs-readonly/Config.in"
     source "$BR2_EXTERNAL_CONSERVIFY_PATH/package/conservify-network/Config.in"
     source "$BR2_EXTERNAL_CONSERVIFY_PATH/package/conservify-tunnels/Config.in"
     source "$BR2_EXTERNAL_CONSERVIFY_PATH/package/data-partition-tools/Config.in"
endmenu
```

## package/bow-tools/Config.in
```kconfig
config BR2_PACKAGE_BOW_TOOLS
        bool "bow-tools"
        help
          Tools from the glacier project.
```

## package/conservify-network/Config.in
```kconfig
config BR2_PACKAGE_CONSERVIFY_NETWORK
        bool "conservify-network"
        help
          Network scripts.
```

## package/conservify-tunnels/Config.in
```kconfig
config BR2_PACKAGE_CONSERVIFY_TUNNELS
        bool "conservify-tunnels"
        help
          Tunnels to our cloud servers.
```

## package/data-partition-tools/Config.in
```kconfig
config BR2_PACKAGE_DATA_PARTITION_TOOLS
        bool "data-partition-tools"
        help
          Tools to maintaining a non-volatile data partition.
```

## package/fake-hwclock/Config.in
```kconfig
config BR2_PACKAGE_FAKE_HWCLOCK
        bool "fake-hwclock"
        help
          Fake hardware clock.
```

## package/initramfs-readonly/Config.in
```kconfig
config BR2_PACKAGE_INITRAMFS_READONLY
        bool "initramfs-readonly"
        help
          Scripts for building an initramfs that mounts a root partition readonly
```

## package/jenkins-agent/Config.in
```kconfig
config BR2_PACKAGE_JENKINS_AGENT
        bool "jenkins-agent"
        help
          Jenkins agent.
```

## package/openjdk/Config.in
```kconfig
config BR2_PACKAGE_OPENJDK
	bool "openjdk"
	select BR2_PACKAGE_ALSA_LIB
	select BR2_PACKAGE_CUPS
	select BR2_PACKAGE_XLIB_LIBXTST
	select BR2_PACKAGE_BUILDROOT_LOCALE
	select BR2_PTHREAD_DEBUG
	select BR2_FONTCONFIG
	depends on BR2_TOOLCHAIN_HAS_THREADS
	help
	  OpenJDK JRE runtime.

	  http://openjdk.java.net/
```

## package/wifi-ap-helpers/Config.in
```kconfig
config BR2_PACKAGE_WIFI_AP_HELPERS
        bool "wifi-ap-helpers"
        help
          Scripts for starting a quick WiFi AP.
```

## package/wireguard-quick/Config.in
```kconfig
config BR2_PACKAGE_WIREGUARD_QUICK
        bool "wireguard-quick"
        help
          The wg-quick script for wireguard.
```
